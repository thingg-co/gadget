## firmware/app/boards/gadget/Kconfig
```kconfig
# Copyright (c) 2026 ThingG
# SPDX-License-Identifier: Apache-2.0

config BOARD_GADGET
	select SOC_NRF54L15_CPUAPP
```

## firmware/app/boards/gadget/board.yml
```yaml
# Copyright (c) 2026 ThingG
# SPDX-License-Identifier: Apache-2.0

board:
  name: gadget
  full_name: ThingG Gadget rev A
  vendor: thingg
  socs:
    - name: nrf54l15
```
